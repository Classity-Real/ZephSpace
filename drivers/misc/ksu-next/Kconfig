## drivers/misc/ksu-next/Kconfig
```kconfig
# SPDX-License-Identifier: GPL-2.0-only

config KSU_NEXT
	tristate "KernelSU-Next root support"
	depends on ARM64
	help
	  KernelSU-Next is a kernel-level root solution for Android. It exposes a
	  /dev/ksu-next control device used by the userspace su binary to grant
	  elevated privileges to applications, and it hides root-owned processes
	  and files from unprivileged processes.

	  This option installs the KernelSU-Next kernel driver together with the
	  ARM64 architecture hook infrastructure
	  (arch/arm64/include/asm/ksu-next.h, arch/arm64/kernel/ksu-next.c).

	  To build as a loadable module, choose M here: the module will be called
	  ksu-next.

	  Note: runtime syscall interception requires KALLSYMS and a kABI-safe
	  patch of sys_call_table (or ftrace). See
	  Documentation/droidspace-ksu-susfs-integration.rst for the integration
	  guide.

	  If unsure, say N.
```

## fs/susfs/Kconfig
```kconfig
# SPDX-License-Identifier: GPL-2.0-only

config SUSFS
	tristate "Sandboxed Userspace FileSystem (SUSFS) support"
	depends on FUSE_FS
	help
	  SUSFS (Sandboxed Userspace FileSystem) is a FUSE-based filesystem that
	  lets unprivileged applications run an isolated userspace filesystem
	  inside a dedicated mount namespace (e.g. for DroidSpace containers).

	  This option registers the SUSFS kernel-side filesystem type. The
	  actual filesystem logic is implemented by the userspace SUSFS daemon,
	  which communicates with the kernel through /dev/fuse (CONFIG_FUSE_FS).

	  To build as a loadable module, choose M here: the module will be called
	  susfs.

	  If unsure, say N.
```
